/******************************************************************************
 * fan_control.c
 *
 * Description:	PWM control for fans on the two cooling
 * 				loops.
 *
 * Needed Peripherals: TIM
 *
 *  Created on: Apr 11, 2025
 *      Author: nimsgernd
 *****************************************************************************/

/*=============================================================================
 |          Includes
 ============================================================================*/

#include "fan_control.h"

/*=============================================================================
 |          Defines
 ============================================================================*/



/*=============================================================================
 |          Function Prototypes
 ============================================================================*/

int fan_output(FANS fan, uint8_t percent);

/*=============================================================================
 |          File Scope Variables
 ============================================================================*/



/*=============================================================================
 |          Function Definitions
 ============================================================================*/

int fan_output(FANS fan, uint8_t percent)
{
	uint8_t pin;
	switch (fan) {
		case FAN1:
			pin = 5;
			break;
		case FAN2:
			pin = 7;
			break;
		default:
			pin = 255;
			break;
	}

	if (pin != 255)
	{
		for (int i = 0; i < PWM_RESOLUTION; i++)
		{
			uint32_t bsrrVal = GPIO_PWM_VAL[i];

			// Set pin bsrr values
			if (i < percent)
			{
				bsrrVal |= (1 << pin);
				bsrrVal &= ~(1 << (pin + 16));
			}
			else
			{
				bsrrVal |= (1 << (pin + 16));
				bsrrVal &= ~(1 << pin);
			}

			// Set bsrr value
			GPIO_PWM_VAL[i] = bsrrVal;
		}
	}

	return 0;
}
